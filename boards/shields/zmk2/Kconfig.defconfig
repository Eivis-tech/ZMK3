## boards/shields/zmk2/Kconfig.defconfig
```kconfig
if SHIELD_ZMK2_LEFT

# Name must be less than 16 characters long!
config ZMK_KEYBOARD_NAME
    default "zmk2"

config ZMK_SPLIT_ROLE_CENTRAL
    default y

config ZMK_SPLIT_BLE_CENTRAL_PERIPHERALS
  default 1

config BT_MAX_CONN
  default 6

config BT_MAX_PAIRED
  default 6

endif

if SHIELD_ZMK2_LEFT || SHIELD_ZMK2_RIGHT

config ZMK_SPLIT
    default y

endif
```

## boards/shields/zmk2/Kconfig.shield
```kconfig
config SHIELD_ZMK2_LEFT
    def_bool $(shields_list_contains,zmk2_left)
  
config SHIELD_ZMK2_RIGHT
    def_bool $(shields_list_contains,zmk2_right)
  
```
